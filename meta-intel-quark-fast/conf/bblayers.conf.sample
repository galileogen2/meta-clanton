## meta-intel-quark-fast/conf/bblayers.conf.sample
```bitbake
# LAYER_CONF_VERSION is increased each time build/conf/bblayers.conf
# changes incompatibly
LCONF_VERSION = "6"

BBPATH = "${TOPDIR}"
BBFILES ?= ""


BBLAYERS ?= " \
  ${BBPATH}/../meta \
  ${BBPATH}/../meta-yocto \
  ${BBPATH}/../meta-intel-iot-devkit \
  ${BBPATH}/../meta-intel-quark-fast \
  ${BBPATH}/../meta-intel-iot-middleware \
  ${BBPATH}/../meta-intel-quark \
  ${BBPATH}/../meta-intel-galileo \
  ${BBPATH}/../meta-netcontiki \
  ${BBPATH}/../meta-openembedded/meta-networking \
  "
BBLAYERS_NON_REMOVABLE ?= " \
  ${BBPATH}/../meta \
  ${BBPATH}/../meta-yocto \
  "
```

## meta-intel-quark-fast/conf/distro/quark-fast.conf
```bitbake
require conf/distro/poky.conf

DISTRO = "quark-fast"

PREFERRED_PROVIDER_virtual/kernel = "linux-yocto-quark"
PREFERRED_VERSION_linux-yocto-quark = "3.14%"

PACKAGE_CLASSES = "package_ipk"

VIRTUAL-RUNTIME_dev_manager = ""
VIRTUAL-RUNTIME_init_manager = "sysvinit"
VIRTUAL-RUNTIME_initscripts = "initscripts"

TMPDIR .= "-fast"
```

## meta-intel-quark-fast/conf/layer.conf
```bitbake
# We have a conf and classes directory, add to BBPATH
BBPATH := "${BBPATH}:${LAYERDIR}"

# We have a recipes directory, add to BBFILES
BBFILES := "${BBFILES} ${LAYERDIR}/recipes-*/*/*.bb \
	${LAYERDIR}/recipes-*/*/*.bbappend"

BBFILE_COLLECTIONS += "intel-quark-fast"
BBFILE_PATTERN_intel-quark-fast := "^${LAYERDIR}/"
BBFILE_PRIORITY_intel-quark-fast = "11"
```

## meta-intel-quark-fast/mkefidisk.wks
```
# short-description: Create an EFI disk image for X1000 targets
# long-description: Creates a partitioned EFI disk image that the user
# can directly dd to boot media.

part /boot --source bootimg-efi --sourceparams="loader=grub-efi" --ondisk mmcblk0 --label msdos --active --align 1024

part / --source rootfs --ondisk mmcblk0 --fstype=ext3 --label platform --align 1024 --size 64

bootloader  --timeout=0  --append="console=ttyS1,115200n8 quiet earlycon=uart8250,mmio32,0x9000b000,115200n8 reboot=efi,warm apic=debug rw LABEL=boot debugshell=5"
```
